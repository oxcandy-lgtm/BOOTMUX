## firmware/esp32s3-router-spike/main/Kconfig.projbuild
```kconfig
menu "BOOTMUX router-spike safety"

config BOOTMUX_USB_NETWORK_EXPERIMENTAL
    bool "Enable experimental USB Ethernet/NCM interface"
    default n
    help
        Exposes the ESP32-S3 to the USB host as an Ethernet device and enables
        the USB-to-Wi-Fi routing experiment. Keep this disabled for normal
        BOOTMUX keyboard use. When disabled the USB configuration is HID-only,
        so plugging the S3 into a Mac cannot inject a DHCP lease, DNS server,
        or default route.

endmenu
```

## firmware/esp32s3-router-spike/sdkconfig.defaults
```kconfig
CONFIG_TINYUSB_HID_COUNT=1
CONFIG_TINYUSB_NET_MODE_NONE=y
# CONFIG_TINYUSB_NET_MODE_NCM is not set
# CONFIG_TINYUSB_NET_MODE_ECM_RNDIS is not set
CONFIG_TINYUSB_DESC_USE_DEFAULT_PID=n
CONFIG_TINYUSB_DESC_USE_ESPRESSIF_VID=y
CONFIG_TINYUSB_DESC_MANUFACTURER_STRING="BOOTMUX"
CONFIG_TINYUSB_DESC_PRODUCT_STRING="BOOTMUX Keyboard Safe"
CONFIG_TINYUSB_DESC_SERIAL_STRING="BOOTMUX-HID-SAFE"
CONFIG_BT_ENABLED=y
CONFIG_BT_NIMBLE_ENABLED=y
# USB Network disabled by default - serial only
CONFIG_BOOTMUX_USB_NETWORK_EXPERIMENTAL=n
# CONFIG_LWIP_IP_FORWARD is not set
# CONFIG_LWIP_IPV4_NAPT is not set
```
